## firmware/esp32-s3-rlcd/boards/higenis/stm32h5_kit/Kconfig.defconfig
```kconfig
# STM32H563ZI Nucleo board configuration

# Copyright (c) 2023 Thomas Stranger
# SPDX-License-Identifier: Apache-2.0

if BOARD_STM32H5_KIT

if NETWORKING

config NET_L2_ETHERNET
	default y

endif # NETWORKING

endif # BOARD_STM32H5_KIT
```

## firmware/esp32-s3-rlcd/boards/higenis/stm32h5_kit/Kconfig.stm32h5_kit
```kconfig
# Copyright (c) 2016 Linaro Limited.
# SPDX-License-Identifier: Apache-2.0

config BOARD_STM32H5_KIT
	select SOC_STM32H563XX

  select USE_STM32_HAL_GPIO
```

## firmware/esp32-s3-rlcd/boards/higenis/stm32h5_kit/board.yml
```yaml
board:
  name: stm32h5_kit
  full_name: STM32H5-KIT
  vendor: higenis
  socs:
    - name: stm32h563xx
```

## firmware/esp32-s3-rlcd/boards/waveshare/esp32s3_rlcd/board.yml
```yaml
board:
  name: esp32s3_rlcd
  full_name: ESP32-S3-RLCD
  vendor: espressif
  socs:
  - name: esp32s3
```
